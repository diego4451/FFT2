## meta-fftenslayer/conf/layer.conf
```bitbake
# We have a conf and classes directory, add to BBPATH
BBPATH .= ":${LAYERDIR}"

# We have recipes-* directories, add to BBFILES
BBFILES += "${LAYERDIR}/recipes-*/*.bb \
		${LAYERDIR}/recipes-*/*/*.bbappend"

BBFILE_COLLECTIONS += "fftenslayer"
BBFILE_PATTERN_fftenslayer = "^${LAYERDIR}/"
BBFILE_PRIORITY_fftenslayer = "5"
LAYERVERSION_fftenslayer = "4"
LAYERSERIES_COMPAT_fftenslayer = "warrior"
```

## meta-fftfulllayer/conf/layer.conf
```bitbake
# We have a conf and classes directory, add to BBPATH
BBPATH .= ":${LAYERDIR}"

# We have recipes-* directories, add to BBFILES
BBFILES += "${LAYERDIR}/recipes-*/*.bb \
        	${LAYERDIR}/recipes-*/*/*.bbappend"

BBFILE_COLLECTIONS += "fftfulllayer"
BBFILE_PATTERN_fftfulllayer = "^${LAYERDIR}/"
BBFILE_PRIORITY_fftfulllayer = "5"
LAYERVERSION_fftfulllayer = "4"
LAYERSERIES_COMPAT_fftfulllayer = "warrior"
```

## meta-fftfullslayer/conf/layer.conf
```bitbake
# We have a conf and classes directory, add to BBPATH
BBPATH .= ":${LAYERDIR}"

# We have recipes-* directories, add to BBFILES
BBFILES += "${LAYERDIR}/recipes-*/*.bb \
		${LAYERDIR}/recipes-*/*/*.bbappend"

BBFILE_COLLECTIONS += "fftfullslayer"
BBFILE_PATTERN_fftfullslayer = "^${LAYERDIR}/"
BBFILE_PRIORITY_fftfullslayer = "5"
LAYERVERSION_fftfullslayer = "4"
LAYERSERIES_COMPAT_fftfullslayer = "warrior"
```

## meta-fftlayer/conf/layer.conf
```bitbake
# We have a conf and classes directory, add to BBPATH
BBPATH .= ":${LAYERDIR}"

# We have recipes-* directories, add to BBFILES
BBFILES += "${LAYERDIR}/recipes-*/*.bb \
        	${LAYERDIR}/recipes-*/*/*.bbappend"

BBFILE_COLLECTIONS += "fftlayer"
BBFILE_PATTERN_fftlayer = "^${LAYERDIR}/"
BBFILE_PRIORITY_fftlayer = "5"
LAYERVERSION_fftlayer = "4"
LAYERSERIES_COMPAT_fftlayer = "warrior"
```

## meta-hellonasmlayer/conf/layer.conf
```bitbake
# We have a conf and classes directory, add to BBPATH
BBPATH .= ":${LAYERDIR}"

# We have recipes-* directories, add to BBFILES
BBFILES += "${LAYERDIR}/recipes-*/*.bb \
        	${LAYERDIR}/recipes-*/*/*.bbappend"

BBFILE_COLLECTIONS += "hellonasmlayer"
BBFILE_PATTERN_hellonasmlayer = "^${LAYERDIR}/"
BBFILE_PRIORITY_hellonasmlayer = "5"
LAYERVERSION_hellonasmlayer = "4"
LAYERSERIES_COMPAT_hellonasmlayer = "warrior"
```
